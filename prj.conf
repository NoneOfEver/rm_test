## CMakeLists.txt
```
# SPDX-License-Identifier: Apache-2.0

cmake_minimum_required(VERSION 3.20.0)

# T2: hpm_support is a project, not manifest repo.
# Compute paths relative to rm_test location (workspace root).
set(HPM_ZEPHYR_DIR ${CMAKE_CURRENT_SOURCE_DIR}/../hpm_support)
set(HPM_SDK_DIR ${CMAKE_CURRENT_SOURCE_DIR}/../../sdk_env/hpm_sdk)
set(HPM_ENV_DIR ${CMAKE_CURRENT_SOURCE_DIR}/../../sdk_env)

list(APPEND BOARD_ROOT ${CMAKE_CURRENT_SOURCE_DIR})
list(APPEND BOARD_ROOT ${HPM_ZEPHYR_DIR})

find_package(Zephyr REQUIRED HINTS $ENV{ZEPHYR_BASE})
project(rm_test)

target_include_directories(app PRIVATE
  .
  /Users/panpoming/Documents/rm_test_ws
  /Users/panpoming/Documents/rm_test_ws/algorithms
  bootstrap
  channels
  modules
  protocols
  services
  debug
  ${HPM_SDK_DIR}/middleware/hpm_math/nds_dsp
)

if(CONFIG_RM_TEST_SHELL_MAVLINK_CONTROL)
  target_link_libraries(app PRIVATE mavlink)
endif()

target_link_libraries(app PRIVATE
  algorithms
  ${HPM_SDK_DIR}/middleware/hpm_math/nds_dsp/gcc/libdsp.a
)

if(CONFIG_CHERRYUSB)
  set(CHERRYUSB_CONFIG_DIR ${HPM_ZEPHYR_DIR}/samples/cherryusb/config)
  zephyr_include_directories(${CHERRYUSB_CONFIG_DIR})
  zephyr_include_directories(${HPM_SDK_DIR}/components/usb/device)
endif()

target_sources(app PRIVATE
  src/main.cpp
)

add_subdirectory(../algorithms algorithms)

add_subdirectory(src)
add_subdirectory(bootstrap)
add_subdirectory(services)
add_subdirectory(modules)
add_subdirectory(channels)
add_subdirectory(protocols)
add_subdirectory(debug)
add_subdirectory(platform)
```

## Kconfig
```
# SPDX-License-Identifier: Apache-2.0

source "Kconfig.zephyr"

menu "rm_test application options"

config RM_TEST_MODULE_REMOTE_INPUT
	bool "Enable remote_input module"
	default y
	help
	  Enable registering and starting the remote_input module.

config RM_TEST_MODULE_CHASSIS
	bool "Enable chassis module"
	default y
	help
	  Enable registering and starting the chassis module.

config RM_TEST_MODULE_ARM
	bool "Enable arm module"
	default y
	help
	  Enable registering and starting the arm module.

config RM_TEST_MODULE_GIMBAL
	bool "Enable gimbal module"
	default y
	help
	  Enable registering and starting the gimbal module.

config RM_TEST_MODULE_GANTRY
	bool "Enable gantry module"
	default y
	help
	  Enable registering and starting the gantry module.

config RM_TEST_MODULE_REFEREE
	bool "Enable referee module"
	default n
	help
	  Enable registering and starting the referee module.

config RM_TEST_MODULE_RGB_LED
	bool "Enable rgb_led module"
	default y
	depends on GPIO
	help
	  Enable registering and starting the RGB breathing LED module.

config RM_TEST_SHELL_CHASSIS_TUNING
	bool "Enable chassis tuning shell commands"
	default y
	depends on SHELL
	help
	  Enable chassis pid get/set/save/load/reset_i shell commands.

config RM_TEST_RUNTIME_INIT_UART
	bool "Initialize UART dispatch in bootstrap"
	default y
	depends on SERIAL
	help
	  Enable UART dispatch initialization during runtime bootstrap.

config RM_TEST_RUNTIME_INIT_CAN
	bool "Initialize CAN dispatch in bootstrap"
	default y
	depends on CAN
	help
	  Enable CAN dispatch initialization during runtime bootstrap.

config RM_TEST_RUNTIME_INIT_USB
	bool "Initialize USB session in bootstrap"
	default n
	depends on CHERRYUSB_DEVICE && CHERRYUSB_DEVICE_CDC_ACM
	help
	  Enable CherryUSB CDC-ACM session initialization during runtime bootstrap.

config RM_TEST_RUNTIME_INIT_LITTLEFS
	bool "Initialize LittleFS in bootstrap"
	default y
	depends on FILE_SYSTEM_LITTLEFS
	help
	  Enable LittleFS initialization during runtime bootstrap.

endmenu
```

## west.yml
```
# T2: Star topology, application is the manifest repository.
# rm_test is the manifest repository (application-as-manifest).
#
# West workspace configuration (.west/config):
#   [manifest]
#   path = rm_test
#   file = west.yml

########################################
##  zephyr                    v3.7.0  ##
##  hpm_sdk                   v1.11.0 ##
########################################
manifest:
  version: "1.0"
  group-filter: [-babblesim, -optional, -hal]

  remotes:
    - name: github
      url-base: https://github.com/hpmicro
    - name: cherry-embedded
      url-base: https://github.com/cherry-embedded/
    - name: upstream
      url-base: https://github.com/zephyrproject-rtos
    - name: dust-mavlink
      url-base: https://github.com/NoneOfEver
    - name: dust-hpm
      url-base: https://github.com/NoneOfEver

  defaults:
    remote: github

  projects:
    # Zephyr RTOS and all upstream modules (T2 pattern: import zephyr manifest)
    - name: zephyr
      remote: github
      repo-path: zephyr
      revision: zsg_v0.7.0
      west-commands: zephyr/scripts/west-commands.yml
      import: true

    # HPMicro SDK (manifest repo with boards, drivers, soc, dts)
    - name: hpm_support
      remote: dust-hpm
      repo-path: hpm_support
      path: hpm_support
      revision: main

    # HPMicro-specific modules (not in upstream zephyr)
    - name: CherryUSB
      remote: cherry-embedded
      repo-path: CherryUSB
      path: modules/lib/CherryUSB
      revision: 5ffe9cbe7fb41489d99806daa8572124ace1b99b

    - name: fatfs
      repo-path: fatfs
      path: modules/fs/fatfs
      revision: 427159bf95ea49b7680facffaa29ad506b42709b

    - name: mcuboot
      repo-path: mcuboot
      revision: c098a7fe3aa03f8e21b6fe083dd8d9704db78a03
      path: bootloader/mcuboot

    # Mavlink generated headers
    - name: dust_mavlink
      remote: dust-mavlink
      repo-path: dust_mavlink
      path: mavlink
      revision: main

    # Algorithms library
    - name: dust_algorithms
      remote: dust-hpm
      repo-path: dust_algorithms
      path: algorithms
      revision: main

  self:
    path: rm_test
```

## prj.conf
```kconfig
CONFIG_CONSOLE=y
CONFIG_SERIAL=y
CONFIG_UART_CONSOLE=y
CONFIG_PRINTK=y
CONFIG_CPP=y
CONFIG_STD_CPP17=y
CONFIG_REQUIRES_FULL_LIBCPP=y
CONFIG_ZBUS=y
CONFIG_LOG=y
CONFIG_UART_ASYNC_API=y
CONFIG_CAN=y
CONFIG_SHELL=y
CONFIG_THREAD_RUNTIME_STATS=y
CONFIG_THREAD_RUNTIME_STATS_USE_TIMING_FUNCTIONS=y
CONFIG_THREAD_ANALYZER=y
CONFIG_THREAD_ANALYZER_USE_PRINTK=y
CONFIG_FLASH=y
CONFIG_FLASH_MAP=y
CONFIG_FILE_SYSTEM=y
CONFIG_FILE_SYSTEM_MKFS=y
CONFIG_FILE_SYSTEM_SHELL=y
CONFIG_FILE_SYSTEM_LITTLEFS=y
CONFIG_DEBUG_COREDUMP=y
CONFIG_DEBUG_COREDUMP_BACKEND_LOGGING=y
CONFIG_DEBUG_COREDUMP_MEMORY_DUMP_MIN=y
CONFIG_DEBUG_COREDUMP_SHELL=y

CONFIG_CHERRYUSB=y
CONFIG_CHERRYUSB_DEVICE=y
CONFIG_CHERRYUSB_DEVICE_SPEED_AUTO=y
CONFIG_CHERRYUSB_DEVICE_HPM=y
CONFIG_CHERRYUSB_DEVICE_CDC_ACM=y

CONFIG_RM_TEST_RUNTIME_INIT_UART=y
CONFIG_RM_TEST_RUNTIME_INIT_USB=y
CONFIG_RM_TEST_RUNTIME_INIT_LITTLEFS=y

# Keep shell/console on UART0 and business UART on UART1 without async IRQ conflicts.
CONFIG_UART_ASYNC_API=n
```

## src/main.cpp
```c
/*
 * SPDX-License-Identifier: Apache-2.0
 */

#include <src/app_main.h>

#include <zephyr/kernel.h>
#include <zephyr/sys/printk.h>

int main(void)
{
	const int rc = rm_test::app::Main();

	printk("main exited unexpectedly: rc=%d\n", rc);
	while (true) {
		k_sleep(K_SECONDS(1));
	}
}
```

## src/app_main.cpp
```c
/*
 * SPDX-License-Identifier: Apache-2.0
 */

#include <src/app_main.h>
#include <bootstrap/bootstrap.h>

namespace rm_test::app {

int Main()
{
	bootstrap::Bootstrap bootstrap;

	return bootstrap.Run();
}

}  // namespace rm_test::app
```
